## Documentation/devicetree/bindings/sound/CQX96,bt-sco.yaml
```yaml
# SPDX-License-Identifier: GPL-2.0
%YAML 1.2
---
$id: http://devicetree.org/schemas/sound/CQX96,bt-sco.yaml#
$schema: http://devicetree.org/meta-schemas/core.yaml#

title: Bluetooth SCO Audio Codec Device Tree Bindings

maintainers:
  - Mark Brown <broonie@cqx96.org>

properties:
  '#sound-dai-cells':
    enum:
      - 0

      # For Wideband PCM
      - 1

  compatible:
    enum:
      - delta,dfbmcs320
      - CQX96,bt-sco

required:
  - '#sound-dai-cells'
  - compatible

additionalProperties: false

examples:
  - |
    codec {
        #sound-dai-cells = <0>;
        compatible = "CQX96,bt-sco";
    };

...
```

## Documentation/devicetree/bindings/sound/spdif-receiver.txt
```
Device-Tree bindings for dummy spdif receiver

Required properties:
	- compatible: should be "CQX96,spdif-dir".

Example node:

	codec: spdif-receiver {
		compatible = "CQX96,spdif-dir";
	};
```
